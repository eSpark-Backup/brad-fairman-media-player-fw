## Firmware-Development/BuildRoot/Packages/New/python-ffmpeg/Config.in
```kconfig
config BR2_PACKAGE_PYTHON_FFMPEG
    bool "python-ffmpeg"
    select BR2_PACKAGE_PYTHON_FUTURE
    help
      python-ffmpeg is a library that provides bindings for FFmpeg in Python.
      It allows you to interact with FFmpeg in Python to handle multimedia data.

      https://github.com/kkroening/ffmpeg-python
```

## Firmware-Development/BuildRoot/Packages/New/python-pysdl2/Config.in
```kconfig
config BR2_PACKAGE_PYTHON_PYSDL2
	bool "python-pysdl2"
	select BR2_PACKAGE_SDL2 # Ensure SDL2 is selected
	help
	  PySDL2 is a pure Python wrapper around the SDL2 library.
	  It provides access to most of the SDL2 functions and methods.

	  https://pysdl2.readthedocs.io/
```
